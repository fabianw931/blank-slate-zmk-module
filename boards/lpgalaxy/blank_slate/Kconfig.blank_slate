## boards/lpgalaxy/blank_slate/Kconfig.blank_slate
```kconfig
# Copyright (c) 2021 Pete Johanson
# SPDX-License-Identifier: Apache-2.0

config BOARD_BLANK_SLATE
	select SOC_NRF52840_QIAA
	select ZMK_BOARD_COMPAT
	imply RETAINED_MEM
	imply RETENTION
	imply RETENTION_BOOT_MODE
```
